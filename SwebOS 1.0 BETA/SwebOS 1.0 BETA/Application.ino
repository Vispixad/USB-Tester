const uint16_t charging [] PROGMEM = {
  0x0000, 0x0000, 0x0000, 0x0000, 0x0000, 0x0000, 0x0000, 0x0000, 0x0000, 0x0000, 0x0000, 0x0000, 0x0000, 0x0000, 0x0000, 0x0000,
  0x0000, 0x0000, 0x0000, 0x0000, 0x0000, 0x0000, 0x0000, 0x0000, 0x0000, 0x0000, 0x0000, 0x0000, 0x0000, 0x0000, 0x0000, 0x0000,
  0x0000, 0x0000, 0x0000, 0x0000, 0x0000, 0x0000, 0x0000, 0x0000, 0x0000, 0x0000, 0x0000, 0x0000, 0x0000, 0x0000, 0x0000, 0x0000,
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  0x0000, 0x0000, 0x0000, 0x0000, 0x0000, 0x0000, 0x0000, 0x0000, 0x0000, 0x0000, 0x0000, 0x0000, 0x0000, 0x0000, 0x0000, 0x0000
};
void drawApp() {
  tft.setRotation(2);
  tft.fillSmoothRoundRect(38, 25, 170, 270, 7, tft.color565(8, 8, 8), tft.color565(8, 8, 8));
  tft.drawSmoothRoundRect(38, 25, 7, 7, 170, 270, tft.color565(21, 21, 21), tft.color565(14, 14, 14));

  tft.fillSmoothRoundRect(128, 167, 70, 118, 5, tft.color565(19, 19, 19), tft.color565(15, 15, 15));
  tft.drawSmoothRoundRect(128, 167, 5, 5, 70, 118, tft.color565(32, 32, 32), tft.color565(14, 14, 14));

  tft.fillSmoothRoundRect(46, 167, 70, 118, 5, tft.color565(19, 19, 19), tft.color565(15, 15, 15));
  tft.drawSmoothRoundRect(46, 167, 5, 5, 70, 118, tft.color565(32, 32, 32), tft.color565(14, 14, 14));

  tft.fillSmoothRoundRect(46, 36, 70, 118, 5, tft.color565(19, 19, 19), tft.color565(15, 15, 15));
  tft.drawSmoothRoundRect(46, 36, 5, 5, 70, 118, tft.color565(32, 32, 32), tft.color565(14, 14, 14));

  tft.fillSmoothRoundRect(128, 36, 70, 118, 5, tft.color565(19, 19, 19), tft.color565(15, 15, 15));
  tft.drawSmoothRoundRect(128, 36, 5, 5, 70, 118, tft.color565(32, 32, 32), tft.color565(14, 14, 14));
  
  tft.fillRoundRect(0, 0, 27, 320, 0, tft.color565(8, 8, 8));
  tft.setRotation(3);
  tft.pushImage(60, 50, 48, 48, charging);
}
void drawTextApp() {
  tft.setRotation(3);
  tft.loadFont(PTSans_Regular18);
  tft.setTextColor(tft.color565(255, 255, 255), tft.color565(120, 120, 120));
  tft.drawString("Application", 107, 8);
  tft.drawString("Opertime:", 27, 220);
  tft.drawString("Fast Charge", 50, 72);
  tft.drawString("Statistics", 180, 72);
  tft.drawString("Toolbox", 60, 143);
  tft.drawString("Setting", 185, 143);
  tft.setRotation(0);
}
void drawChoiceApp() {
  if (!timeoverapp) {
    const unsigned long interval = 1000;
    static unsigned long previousMillis = 0;
    unsigned long currentMillis = millis();
    if (currentMillis - previousMillis >= interval) {
      previousMillis = currentMillis;
      RealTime(days, hours, minutes, seconds);
      tft.setRotation(3);
      TimeAppSprite.fillSprite(tft.color565(8, 8, 8));
      TimeAppSprite.setTextColor(tft.color565(255, 255, 255), tft.color565(110, 110, 110));
      TimeAppSprite.loadFont(PTSans_Regular18);
      char buffer[20];
      sprintf(buffer, "%d Days - %02d:%02d:%02d", days, hours, minutes % 60, seconds % 60);
      TimeAppSprite.drawString(buffer, 3, 0);
      TimeAppSprite.pushSprite(105, 220);
    }
  } else {
  }
  static unsigned long lastButtonUpTime = 0;
  static const unsigned long singleButtonClickDelay = 150;
  unsigned long currentMillisApp = millis();
  if (currentMillisApp - lastButtonUpTime >= singleButtonClickDelay) {
    if (digitalRead(BUTTON_UP) == LOW) {
      if (!menuappr) {
        lastButtonUpTime = currentMillisApp;
        tollup = true;
        statup = true;
        setdown = true;
        PushApp++;
        if (PushApp > 4) {
          PushApp = 1;
        }
        changeRectangleColor(PushApp);
      }
    }
  }
}
void RealTime(unsigned long& days, unsigned long& hours, unsigned long& minutes, unsigned long& seconds) {
  static unsigned long startTime = millis();
  unsigned long currentTime = millis();
  unsigned long elapsedTime = currentTime - startTime;
  seconds = elapsedTime / 1000;
  minutes = seconds / 60;
  hours = minutes / 60;
  days = hours / 24;
}
void changeRectangleColor(int rectangleNumber) {
  selectedRectangle = rectangleNumber;
  uint16_t selectedFillColor1 = tft.color565(10, 32, 64);
  uint16_t selectedFillColor2 = TFT_BLACK;
  uint16_t selectedBorderColor1 = tft.color565(19, 89, 191);
  uint16_t selectedBorderColor2 = tft.color565(10, 32, 64);
  uint16_t unselectedFillColor1 = tft.color565(19, 19, 19);
  uint16_t unselectedFillColor2 = tft.color565(15, 15, 15);
  uint16_t unselectedBorderColor1 = tft.color565(32, 32, 32);
  uint16_t unselectedBorderColor2 = tft.color565(14, 14, 14);

  for (int i = 1; i <= 4; i++) {
    uint16_t fillColor1 = (i == rectangleNumber) ? selectedFillColor1 : unselectedFillColor1;
    uint16_t fillColor2 = (i == rectangleNumber) ? selectedFillColor2 : unselectedFillColor2;
    uint16_t borderColor1 = (i == rectangleNumber) ? selectedBorderColor1 : unselectedBorderColor1;
    uint16_t borderColor2 = (i == rectangleNumber) ? selectedBorderColor2 : unselectedBorderColor2;
    drawRectangle(i, fillColor1, fillColor2, borderColor1, borderColor2);
  }
}

void drawRectangle(int rectangleNumber, uint16_t fillColor1, uint16_t fillColor2, uint16_t borderColor1, uint16_t borderColor2) {
  int16_t rectX, rectY, rectWidth, rectHeight, cornerRadius;
  if (rectangleNumber < 1 || rectangleNumber > 4)
    return;

  switch (rectangleNumber) {
    case 1:
      rectX = 41; rectY = 165; rectWidth = 70; rectHeight = 118; cornerRadius = 5;
      break;
    case 2:
      rectX = 41; rectY = 34; rectWidth = 70; rectHeight = 118; cornerRadius = 5;
      break;
    case 3:
      rectX = 123; rectY = 165; rectWidth = 70; rectHeight = 118; cornerRadius = 5;
      break;
    case 4:
      rectX = 123; rectY = 34; rectWidth = 70; rectHeight = 118; cornerRadius = 5;
      break;
  }

  tft.setRotation(0);
  tft.fillSmoothRoundRect(rectX, rectY, rectWidth, rectHeight, cornerRadius, fillColor1, fillColor2);
  tft.drawSmoothRoundRect(rectX, rectY, cornerRadius, cornerRadius, rectWidth, rectHeight, borderColor1, borderColor2);
  tft.setRotation(3);
  tft.loadFont(PTSans_Regular18);
  tft.setTextColor(tft.color565(255, 255, 255), tft.color565(120, 120, 120));
  tft.drawString("Application", 107, 8);
  tft.drawString("Opertime:", 27, 220);
  tft.drawString("Fast Charge", 50, 72);
  tft.drawString("Statistics", 180, 72);
  tft.drawString("Toolbox", 60, 143);
  tft.drawString("Setting", 185, 143);
  tft.setRotation(0);
}
