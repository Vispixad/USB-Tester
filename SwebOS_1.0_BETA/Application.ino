const uint16_t charging [] PROGMEM = {
  0x0000, 0x0000, 0x0000, 0x0000, 0x0000, 0x0000, 0x0000, 0x0000, 0x0000, 0x0000, 0x0000, 0x0000, 0x0000, 0x0000, 0x0000, 0x0000,
  0x0000, 0x0000, 0x0000, 0x0000, 0x0000, 0x0000, 0x0000, 0x0000, 0x0000, 0x0000, 0x0000, 0x0000, 0x0000, 0x0000, 0x0000, 0x0000,
  0x0000, 0x0000, 0x0000, 0x0000, 0x0000, 0x0000, 0x0000, 0x0000, 0x0000, 0x0000, 0x0000, 0x0000, 0x0000, 0x0000, 0x0000, 0x0000,
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  0x0000, 0x0000, 0x0000, 0x0000, 0x0000, 0x0000, 0x0000, 0x0000, 0x0000, 0x0000, 0x0000, 0x0000, 0x0000, 0x0000, 0x0000, 0x0000
};
void drawApp() {
  tft.setRotation(2);
  tft.fillSmoothRoundRect(38, 25, 170, 270, 7, tft.color565(8, 8, 8), TFT_BLACK);
  tft.drawRoundRect(38, 25, 170, 270, 7, tft.color565(21, 21, 21));
  tft.fillRoundRect(125, 164, 72, 122, 4, tft.color565(19, 19, 19));
  tft.drawRoundRect(125, 164, 72, 122, 4, tft.color565(32, 32, 32));
  tft.fillRoundRect(47, 164, 72, 122, 4, tft.color565(19, 19, 19));
  tft.drawRoundRect(47, 164, 72, 122, 4, tft.color565(32, 32, 32));
  tft.fillRoundRect(47, 34, 72, 122, 4, tft.color565(19, 19, 19));
  tft.drawRoundRect(47, 34, 72, 122, 4, tft.color565(32, 32, 32));
  tft.fillRoundRect(125, 34, 72, 122, 4, tft.color565(19, 19, 19));
  tft.drawRoundRect(125, 34, 72, 122, 4, tft.color565(32, 32, 32));
  tft.fillRoundRect(0, 0, 27, 320, 0, tft.color565(8, 8, 8));
  tft.setRotation(3);
  tft.pushImage(60, 50, 48, 48, charging);
}
void drawTextApp() {
  tft.setRotation(3);
  tft.setFreeFont(&PTSans_Regular9pt7b);
  tft.setTextSize(1);
  uint16_t textColor1 = tft.color565(255, 255, 255);
  tft.setTextColor(textColor1);
  tft.drawString("Application", 107, 7);
  tft.setTextColor(textColor1);
  tft.drawString("Opertime:", 27, 217);
  tft.setTextColor(textColor1);
  tft.drawString("Fast Charge", 50, 87);
  tft.setTextColor(textColor1);
  tft.drawString("Statistics", 180, 87);
  tft.setTextColor(textColor1);
  tft.drawString("Toolbox", 60, 158);
  tft.setTextColor(textColor1);
  tft.drawString("Setting", 185, 158);
  tft.setRotation(0);
}
void drawChoiceApp() {
  if (!timeoverapp) {
    const unsigned long interval = 1000;
    static unsigned long previousMillis = 0;
    unsigned long currentMillis = millis();
    if (currentMillis - previousMillis >= interval) {
      previousMillis = currentMillis;
      RealTime(days, hours, minutes, seconds);
      /*tft.fillRect(4, 107, 20, 130, tft.color565(8, 8, 8));*/
      tft.setRotation(3);
      TimeAppSprite.fillSprite(tft.color565(8, 8, 8));
      TimeAppSprite.setTextColor(TFT_WHITE);
      TimeAppSprite.setFreeFont(&PTSans_Regular9pt7b);
      char buffer[20];
      sprintf(buffer, "%d Days - %02d:%02d:%02d", days, hours, minutes % 60, seconds % 60);
      TimeAppSprite.drawString(buffer, 3, 0);
      TimeAppSprite.pushSprite(105, 217);
      /*tft.setTextColor(tft.color565(255, 255, 255));
        tft.setTextSize(1);
        tft.setCursor(110, 231);*/
      /*tft.print(days);
        tft.print(" Days");
        tft.print(" - ");
        tft.print(hours);
        tft.print(":");
        if (minutes < 10) tft.print("0");
        tft.print(minutes % 60);
        tft.print(":");
        if (seconds < 10) tft.print("0");
        tft.print(seconds % 60);*/
    }
  } else {
  }
  static unsigned long lastButtonUpTime = 0;
  static const unsigned long singleButtonClickDelay = 150;
  unsigned long currentMillisApp = millis();
  if (currentMillisApp - lastButtonUpTime >= singleButtonClickDelay) {
    if (digitalRead(BUTTON_UP) == LOW) {
      if (!menuappr) {
        lastButtonUpTime = currentMillisApp;
        tollup = true;
        statup = true;
        setdown = true;
        PushApp++;
        if (PushApp > 4) {
          PushApp = 1;
        }
        changeRectangleColor(PushApp);
      }
    }
  }
}
void RealTime(unsigned long& days, unsigned long& hours, unsigned long& minutes, unsigned long& seconds) {
  static unsigned long startTime = millis();
  unsigned long currentTime = millis();
  unsigned long elapsedTime = currentTime - startTime;
  seconds = elapsedTime / 1000;
  minutes = seconds / 60;
  hours = minutes / 60;
  days = hours / 24;
}
void changeRectangleColor(int rectangleNumber) {
  selectedRectangle = rectangleNumber;
  uint16_t selectedFillColor = tft.color565(10, 32, 64);
  uint16_t selectedBorderColor = tft.color565(19, 89, 191);
  uint16_t unselectedFillColor = tft.color565(19, 19, 19);
  uint16_t unselectedBorderColor = tft.color565(32, 32, 32);
  for (int i = 1; i <= 4; i++) {
    uint16_t fillColor = (i == rectangleNumber) ? selectedFillColor : unselectedFillColor;
    uint16_t borderColor = (i == rectangleNumber) ? selectedBorderColor : unselectedBorderColor;
    drawRectangle(i, fillColor, borderColor);
  }
}
void drawRectangle(int rectangleNumber, uint16_t fillColor, uint16_t borderColor) {
  int16_t rectX, rectY, rectWidth, rectHeight, cornerRadius;
  if (rectangleNumber < 1 || rectangleNumber > 4)
    return;
  switch (rectangleNumber) {
    case 1: rectX = 43; rectY = 164; rectWidth = 72; rectHeight = 122; cornerRadius = 4;
      break;
    case 2: rectX = 43; rectY = 34; rectWidth = 72; rectHeight = 122; cornerRadius = 4;
      break;
    case 3: rectX = 121; rectY = 164; rectWidth = 72; rectHeight = 122; cornerRadius = 4;
      break;
    case 4: rectX = 121; rectY = 34; rectWidth = 72; rectHeight = 122; cornerRadius = 4;
      break;
  }
  tft.setRotation(0);
  tft.fillRoundRect(rectX, rectY, rectWidth, rectHeight, cornerRadius, fillColor);
  tft.drawRoundRect(rectX, rectY, rectWidth, rectHeight, cornerRadius, borderColor);
  tft.setRotation(3);
  tft.setTextSize(1);
  tft.setFreeFont(&PTSans_Regular9pt7b);
  uint16_t textColor1 = tft.color565(255, 255, 255);
  tft.setTextColor(textColor1);
  tft.drawString("Fast Charge", 40, 67);
  tft.setTextColor(textColor1);
  tft.drawString("Statistics", 160, 71);
  tft.setTextColor(textColor1);
  tft.drawString("Toolbox", 50, 148);
  tft.setTextColor(textColor1);
  tft.drawString("Setting", 170, 148);
  tft.setRotation(0);
}
